## board/boards/arm/lpcxpresso55s69_unsecure/lpcxpresso55s69_unsecure_defconfig
```kconfig
CONFIG_SOC_SERIES_LPC55XXX=y
CONFIG_SOC_LPC55S69_CPU0=y
CONFIG_BOARD_LPCXPRESSO55S69_CPU0=y
CONFIG_CONSOLE=y
CONFIG_UART_CONSOLE=y
CONFIG_SERIAL=y
CONFIG_UART_INTERRUPT_DRIVEN=y
CONFIG_GPIO=y
CONFIG_SYS_CLOCK_HW_CYCLES_PER_SEC=150000000
CONFIG_PINCTRL=y

# TFM sets up MPU_NS, can't correctly change this configuration yet
CONFIG_ARM_MPU=n

# Disable TrustZone-M
CONFIG_TRUSTED_EXECUTION_NONSECURE=n
CONFIG_RUNTIME_NMI=n
CONFIG_ARM_TRUSTZONE_M=n
CONFIG_BUILD_WITH_TFM=n

CONFIG_BUILD_OUTPUT_HEX=y
```
