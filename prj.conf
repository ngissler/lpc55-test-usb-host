## CMakeLists.txt
```
cmake_minimum_required(VERSION 3.20.0)

set(BOARD_ROOT ${CMAKE_CURRENT_SOURCE_DIR}/board)
set(BOARD lpcxpresso55s69_unsecure)

find_package(Zephyr REQUIRED HINTS $ENV{ZEPHYR_BASE})

include_directories(${CMAKE_SOURCE_DIR}/include)
include_directories(${CMAKE_SOURCE_DIR}/src)

SET(USE_USB_WITH_ZPHYR_RTOS FALSE)

IF (USE_USB_WITH_ZPHYR_RTOS)
add_definitions(-DFSL_RTOS_ZEPHYR=1) 
SET(SRC src/host_msd_command_task.c)
ELSE()
SET(SRC src/host_msd_command.c)
ENDIF (USE_USB_WITH_ZPHYR_RTOS)

include(${CMAKE_SOURCE_DIR}/nxp_mcux_usb_host/build.cmake)

project(lpc55-test-usb-host C CXX ASM)
target_sources(app PRIVATE 
${nxp_mcux_usb_host_SRC}
${SRC}
src/main.c
)
```

## west.yml
```
manifest:
  remotes:
    - name: das
      url-base: https://git.lacie.com/das
    - name: daspro
      url-base: https://git.lacie.com/daspro
    - name: dev
      url-base: https://git.lacie.com/dev      

  self:
    path: lpc55-test-usb-host

  projects:
    - name: zephyr
      url: https://git.lacie.com/dev/zephyr.git
      revision: 07c6af3b8c35c1e49186578ca61a25c76e2fb308
      path: zephyr
      west-commands: scripts/west-commands.yml
      import:
        name-allowlist:
          - cmsis
          - hal_nxp
```

## prj.conf
```kconfig
# System configuration
#---------------------
CONFIG_INIT_STACKS=y
CONFIG_ASSERT=y

CONFIG_HEAP_MEM_POOL_SIZE=98304
CONFIG_NEWLIB_LIBC=y
CONFIG_NEWLIB_LIBC_NANO=y

CONFIG_MAIN_STACK_SIZE=8192
CONFIG_MAIN_THREAD_PRIORITY=2

CONFIG_ISR_STACK_SIZE=4096

# Drivers
#--------
CONFIG_INIT_PLL0=y
CONFIG_USB_DEVICE_DRIVER=y

# Debug configuration
#-------------------
CONFIG_LOG=y
CONFIG_SERIAL=y
CONFIG_LOG_MODE_IMMEDIATE=y

CONFIG_STACK_USAGE=y
CONFIG_USERSPACE=n
CONFIG_NO_OPTIMIZATIONS=y

# Features
#---------
CONFIG_EVENTS=y
```

## src/main.c
```c
#include <zephyr/device.h>
#include <errno.h>
#include <zephyr/sys/util.h>
#include <zephyr/kernel.h>
#include <assert.h>
#include <zephyr/drivers/gpio.h>

#include <stdlib.h>
#define LOG_LEVEL CONFIG_LOG_DEFAULT_LEVEL
#include <zephyr/logging/log.h>
LOG_MODULE_REGISTER(main);

// Needed so usb_host functions got what is in usb_host_config.h. Ugly
#include "usb_host_config.h"
#include "usb_host.h"

#include "host_msd_command.h"

#include "usb_host_app.h"

#include "test_osa.h"

int main(void)
{
    printk("Starting main\n");
    usb_echo("usb_echo is working\n");

    usb_host_app_init();
    //test_event();
    //test_OSA_mutex();
    while (1) {
        k_sleep(K_MSEC(1000));
    }

    k_panic();
    return 0;
}

#define MAX_STRING_LENGTH 96 // dont put too much, it stresses the stack

int DbgConsole_Printf(const char *fmt_s, ...)
{
    int ret;
    char str[MAX_STRING_LENGTH];
    va_list vl;    
    va_start(vl, fmt_s);
    ret = vsnprintk(str, MAX_STRING_LENGTH - 1, fmt_s, vl);
    printk("%s", str);
    va_end(vl);
    return ret;
}
```

## include/host_msd_command.h
```c
/*
 * Copyright (c) 2015, Freescale Semiconductor, Inc.
 * Copyright 2016 - 2018 NXP
 * All rights reserved.
 *
 * SPDX-License-Identifier: BSD-3-Clause
 */

#ifndef _HOST_MSD_COMMAND_H_
#define _HOST_MSD_COMMAND_H_

#include "usb_host.h"
#include "usb_host_msd.h"
#include <zephyr/kernel.h>
/*******************************************************************************
 * Definitions
 ******************************************************************************/

/*! @brief 1 - execute throughput test; 0 - don't execute throughput test */
#define MSD_THROUGHPUT_TEST_ENABLE (0U)

/*! @brief host app run status */
typedef enum _usb_host_msd_run_state
{
    kUSB_HostMsdRunIdle = 0,         /*!< idle */
    kUSB_HostMsdRunSetInterface,     /*!< execute set interface code */
    kUSB_HostMsdRunWaitSetInterface, /*!< wait set interface done */
    kUSB_HostMsdRunMassStorageTest   /*!< execute mass storage test code */
} usb_host_msd_run_state_t;

/*! @brief USB host msd command instance structure */
typedef struct _usb_host_msd_command_instance
{
    usb_host_configuration_handle configHandle; /*!< configuration handle */
    usb_device_handle deviceHandle;             /*!< device handle */
    usb_host_class_handle classHandle;          /*!< class handle */
    usb_host_interface_handle interfaceHandle;  /*!< interface handle */
    struct k_sem *commandSemaphore;             /*!< semaphore for waiting msd command callback */
    uint8_t *testUfiBuffer;                     /*!< test buffer */
    uint8_t prevDeviceState;                    /*!< device attach/detach previous status */
    uint8_t deviceState;                        /*!< device attach/detach status */
    uint8_t runWaitState; /*!< application wait status, go to next run status when the wait status success */
    uint8_t runState;     /*!< application run status */
} usb_host_msd_command_instance_t;

/*******************************************************************************
 * API
 ******************************************************************************/

/*!
 * @brief host msd callback function.
 *
 * This function should be called in the host callback function.
 *
 * @param deviceHandle        device handle.
 * @param configurationHandle attached device's configuration descriptor information.
 * @param eventCode           callback event code, please reference to enumeration host_event_t.
 *
 * @retval kStatus_USB_Success              The host is initialized successfully.
 * @retval kStatus_USB_NotSupported         The configuration don't contain msd interface.
 * @retval kStatus_USB_Error                There is no idle msd instance.
 */
extern usb_status_t USB_HostMsdEvent(usb_device_handle deviceHandle,
                                     usb_host_configuration_handle configurationHandle,
                                     uint32_t eventCode);

/*!
 * @brief host msd command task function.
 *
 * This function implements the host msd command action, it is used to create task.
 *
 * @param arg   the host msd command instance pointer.
 */
extern void USB_HostMsdTask(void *arg);

#endif /* _HOST_MSD_COMMAND_H_ */
```

## src/hello_world.c
```c
/*
 * Copyright (c) 2012-2014 Wind River Systems, Inc.
 *
 * SPDX-License-Identifier: Apache-2.0
 */

#include <zephyr/device.h>
#include <errno.h>
#include <zephyr/sys/util.h>
#include <zephyr/kernel.h>
#include <assert.h>
#include <zephyr/drivers/gpio.h>

#include <stdlib.h>
#define LOG_LEVEL CONFIG_LOG_DEFAULT_LEVEL
#include <zephyr/logging/log.h>
LOG_MODULE_REGISTER(main);

void main(void)
{
    while (1)
	   printk("Hello World! %s\n", CONFIG_BOARD);
}
```

## src/host_msd_command.c
```c
/*
 * Copyright (c) 2015 - 2016, Freescale Semiconductor, Inc.
 * Copyright 2016, 2018 NXP
 * All rights reserved.
 *
 * SPDX-License-Identifier: BSD-3-Clause
 */

#include "usb_host_config.h"
#include "usb_host.h"
#include "usb_host_msd.h"
#include "host_msd_command.h"
#include "usb_host_app.h"


/*******************************************************************************
 * Definitions
 ******************************************************************************/

#if MSD_THROUGHPUT_TEST_ENABLE
#include "fsl_device_registers.h"
#define THROUGHPUT_BUFFER_SIZE (64 * 1024) /* throughput test buffer */
#define MCU_CORE_CLOCK (120000000)         /* mcu core clock, user need to configure it. */
#endif                                     /* MSD_THROUGHPUT_TEST_ENABLE */

/*******************************************************************************
 * Prototypes
 ******************************************************************************/

/*!
 * @brief host msd ufi command callback.
 *
 * This function is used as callback function for ufi command.
 *
 * @param param      the host msd command instance pointer.
 * @param data       data buffer pointer.
 * @param dataLength data length.
 * @status           transfer result status.
 */
static void USB_HostMsdUfiCallback(void *param, uint8_t *data, uint32_t dataLength, usb_status_t status);

/*!
 * @brief host msd control transfer callback.
 *
 * This function is used as callback function for control transfer .
 *
 * @param param      the host msd command instance pointer.
 * @param data       data buffer pointer.
 * @param dataLength data length.
 * @status           transfer result status.
 */
static void USB_HostMsdControlCallback(void *param, uint8_t *data, uint32_t dataLength, usb_status_t status);

/*!
 * @brief host msd command test done.
 *
 * @param msdCommandInstance   the host command instance pointer.
 */
static void msd_command_test_done(usb_host_msd_command_instance_t *msdCommandInstance);

/*!
 * @brief host msd command test.
 *
 * This function implements msd command test.
 *
 * @param msdCommandInstance   the host command instance pointer.
 */
static void USB_HostMsdCommandTest(usb_host_msd_command_instance_t *msdCommandInstance);

/*******************************************************************************
 * Variables
 ******************************************************************************/
extern usb_host_handle g_HostHandle;                        /* global host handle */
usb_host_msd_command_instance_t g_MsdCommandInstance = {0}; /* global msd command instance */
/* command on-going state. It should set to 1 when start command, it is set to 0 in the callback */
volatile uint8_t ufiIng;
/* command callback status */
volatile usb_status_t ufiStatus;

USB_DMA_NONINIT_DATA_ALIGN(USB_DATA_ALIGN_SIZE) static uint8_t s_TestUfiBuffer[512]; /*!< test buffer */

#if MSD_THROUGHPUT_TEST_ENABLE
USB_DMA_NONINIT_DATA_ALIGN(USB_DATA_ALIGN_SIZE)
static uint32_t testThroughputBuffer[THROUGHPUT_BUFFER_SIZE / 4]; /* the buffer for throughput test */
uint32_t testSizeArray[] = {50 * 1024, 50 * 1024};                /* test time and test size (uint: K) */
#endif                                                            /* MSD_THROUGHPUT_TEST_ENABLE */

/*******************************************************************************
 * Code
 ******************************************************************************/

static void USB_HostMsdUfiCallback(void *param, uint8_t *data, uint32_t dataLength, usb_status_t status)
{
    ufiIng    = 0;
    ufiStatus = status;
}

static void USB_HostMsdControlCallback(void *param, uint8_t *data, uint32_t dataLength, usb_status_t status)
{
    usb_host_msd_command_instance_t *msdCommandInstance = (usb_host_msd_command_instance_t *)param;

    if (msdCommandInstance->runWaitState == kUSB_HostMsdRunWaitSetInterface) /* set interface finish */
    {
        msdCommandInstance->runWaitState = kUSB_HostMsdRunIdle;
        msdCommandInstance->runState     = kUSB_HostMsdRunMassStorageTest;
    }
}

static void msd_command_test_done(usb_host_msd_command_instance_t *msdCommandInstance)
{
    usb_echo("........................test done....................\r\n");
}

static inline void USB_HostControllerTaskFunction(usb_host_handle hostHandle)
{
#if ((defined USB_HOST_CONFIG_KHCI) && (USB_HOST_CONFIG_KHCI))
    USB_HostKhciTaskFunction(hostHandle);
#endif /* USB_HOST_CONFIG_KHCI */
#if ((defined USB_HOST_CONFIG_EHCI) && (USB_HOST_CONFIG_EHCI))
    USB_HostEhciTaskFunction(hostHandle);
#endif /* USB_HOST_CONFIG_EHCI */
#if ((defined USB_HOST_CONFIG_OHCI) && (USB_HOST_CONFIG_OHCI > 0U))
    USB_HostOhciTaskFunction(g_HostHandle);
#endif /* USB_HOST_CONFIG_OHCI */
#if ((defined USB_HOST_CONFIG_IP3516HS) && (USB_HOST_CONFIG_IP3516HS > 0U))
    USB_HostIp3516HsTaskFunction(g_HostHandle);
#endif /* USB_HOST_CONFIG_IP3516HS */
}

static void USB_HostMsdCommandTest(usb_host_msd_command_instance_t *msdCommandInstance)
{
    usb_status_t status;
    uint32_t blockSize = 512;
    uint32_t address;

    usb_echo("........................test start....................\r\n");

    usb_echo("get max logical units....");
    ufiIng = 1;
    status = USB_HostMsdGetMaxLun(msdCommandInstance->classHandle, msdCommandInstance->testUfiBuffer,
                                  USB_HostMsdUfiCallback, msdCommandInstance);
    if (status != kStatus_USB_Success)
    {
        usb_echo("error\r\n");
        msd_command_test_done(msdCommandInstance);
        return;
    }
    while (ufiIng) /* wait the command */
    {
        USB_HostControllerTaskFunction(g_HostHandle);
    }
    if (ufiStatus == kStatus_USB_Success) /* print the command result */
    {
        usb_echo("success, logical units: %d\r\n", msdCommandInstance->testUfiBuffer[0]);
    }
    else
    {
        usb_echo("fail\r\n");
        msd_command_test_done(msdCommandInstance);
        return;
    }

    if (msdCommandInstance->deviceState != kStatus_DEV_Attached)
    {
        msd_command_test_done(msdCommandInstance);
        return;
    }
    usb_echo("test unit ready....");
    ufiIng = 1;
    status = USB_HostMsdTestUnitReady(msdCommandInstance->classHandle, 0, USB_HostMsdUfiCallback, msdCommandInstance);
    if (status != kStatus_USB_Success)
    {
        usb_echo("error\r\n");
        msd_command_test_done(msdCommandInstance);
        return;
    }
    while (ufiIng) /* wait the command */
    {
        USB_HostControllerTaskFunction(g_HostHandle);
    }
    if ((ufiStatus == kStatus_USB_Success) || (ufiStatus == kStatus_USB_MSDStatusFail)) /* print the command result */
    {
        usb_echo("success, unit status: %s\r\n", ufiStatus == kStatus_USB_MSDStatusFail ? "not ready" : "ready");
    }
    else
    {
        usb_echo("fail\r\n");
        msd_command_test_done(msdCommandInstance);
        return;
    }

    if (msdCommandInstance->deviceState != kStatus_DEV_Attached)
    {
        msd_command_test_done(msdCommandInstance);
        return;
    }
    usb_echo("request sense....");
    ufiIng = 1;
    status = USB_HostMsdRequestSense(msdCommandInstance->classHandle, 0, msdCommandInstance->testUfiBuffer,
                                     sizeof(usb_host_ufi_sense_data_t), USB_HostMsdUfiCallback, msdCommandInstance);
    if (status != kStatus_USB_Success)
    {
        usb_echo("error\r\n");
        msd_command_test_done(msdCommandInstance);
        return;
    }
    while (ufiIng) /* wait the command */
    {
        USB_HostControllerTaskFunction(g_HostHandle);
    }
    if (ufiStatus == kStatus_USB_Success) /* print the command result */
    {
        usb_echo("success\r\n");
    }
    else
    {
        usb_echo("fail\r\n");
        msd_command_test_done(msdCommandInstance);
        return;
    }

    if (msdCommandInstance->deviceState != kStatus_DEV_Attached)
    {
        msd_command_test_done(msdCommandInstance);
        return;
    }
    usb_echo("inquiry...");
    ufiIng = 1;
    status = USB_HostMsdInquiry(msdCommandInstance->classHandle, 0, msdCommandInstance->testUfiBuffer,
                                sizeof(usb_host_ufi_inquiry_data_t), USB_HostMsdUfiCallback, msdCommandInstance);
    if (status != kStatus_USB_Success)
    {
        usb_echo("error\r\n");
        msd_command_test_done(msdCommandInstance);
        return;
    }
    while (ufiIng) /* wait the command */
    {
        USB_HostControllerTaskFunction(g_HostHandle);
    }
    if (ufiStatus == kStatus_USB_Success) /* print the command result */
    {
        usb_echo("success\r\n");
    }
    else
    {
        usb_echo("fail\r\n");
        msd_command_test_done(msdCommandInstance);
        return;
    }

    if (msdCommandInstance->deviceState != kStatus_DEV_Attached)
    {
        msd_command_test_done(msdCommandInstance);
        return;
    }
    usb_echo("read capacity...");
    ufiIng = 1;
    status = USB_HostMsdReadCapacity(msdCommandInstance->classHandle, 0, msdCommandInstance->testUfiBuffer,
                                     sizeof(usb_host_ufi_read_capacity_t), USB_HostMsdUfiCallback, msdCommandInstance);
    if (status != kStatus_USB_Success)
    {
        usb_echo("error\r\n");
        msd_command_test_done(msdCommandInstance);
        return;
    }
    while (ufiIng) /* wait the command */
    {
        USB_HostControllerTaskFunction(g_HostHandle);
    }
    if (ufiStatus == kStatus_USB_Success) /* print the command result */
    {
        address   = (uint32_t) & (msdCommandInstance->testUfiBuffer[0]);
        address   = (uint32_t)((usb_host_ufi_read_capacity_t *)(address))->blockLengthInBytes;
        blockSize = USB_LONG_FROM_BIG_ENDIAN_ADDRESS(((uint8_t *)address));
        address   = (uint32_t) & (msdCommandInstance->testUfiBuffer[0]);
        address   = (uint32_t)((usb_host_ufi_read_capacity_t *)(address))->lastLogicalBlockAddress;
        usb_echo("success, last logical block:%d block length:%d\r\n",
                 USB_LONG_FROM_BIG_ENDIAN_ADDRESS(((uint8_t *)address)), blockSize);
    }
    else
    {
        usb_echo("fail\r\n");
        msd_command_test_done(msdCommandInstance);
        return;
    }

    if (msdCommandInstance->deviceState != kStatus_DEV_Attached)
    {
        msd_command_test_done(msdCommandInstance);
        return;
    }
    if (blockSize == 0)
    {
        blockSize = 512;
    }
    usb_echo("read(10)...");
    ufiIng = 1;
    status = USB_HostMsdRead10(msdCommandInstance->classHandle, 0, 0, msdCommandInstance->testUfiBuffer, blockSize, 1,
                               USB_HostMsdUfiCallback, msdCommandInstance);
    if (status != kStatus_USB_Success)
    {
        usb_echo("error\r\n");
        msd_command_test_done(msdCommandInstance);
        return;
    }
    while (ufiIng) /* wait the command */
    {
        USB_HostControllerTaskFunction(g_HostHandle);
    }
    if (ufiStatus == kStatus_USB_Success) /* print the command result */
    {
        usb_echo("success\r\n");
    }
    else
    {
        usb_echo("fail\r\n");
        msd_command_test_done(msdCommandInstance);
        return;
    }

    if (msdCommandInstance->deviceState != kStatus_DEV_Attached)
    {
        msd_command_test_done(msdCommandInstance);
        return;
    }
    usb_echo("write(10)...");
    ufiIng = 1;
    status = USB_HostMsdWrite10(msdCommandInstance->classHandle, 0, 0, msdCommandInstance->testUfiBuffer, blockSize, 1,
                                USB_HostMsdUfiCallback, msdCommandInstance);
    if (status != kStatus_USB_Success)
    {
        usb_echo("error\r\n");
        msd_command_test_done(msdCommandInstance);
        return;
    }
    while (ufiIng) /* wait the command */
    {
        USB_HostControllerTaskFunction(g_HostHandle);
    }
    if (ufiStatus == kStatus_USB_Success) /* print the command result */
    {
        usb_echo("success\r\n");
    }
    else
    {
        usb_echo("fail\r\n");
        msd_command_test_done(msdCommandInstance);
        return;
    }

#if MSD_THROUGHPUT_TEST_ENABLE
    uint64_t totalTime;
    uint32_t testSize;
    uint32_t blockAddress;
    uint8_t testIndex;

    /* time delay (~100ms) */
    for (testSize = 0; testSize < 400000; ++testSize)
    {
        __NOP();
    }

    CoreDebug->DEMCR |= (1 << CoreDebug_DEMCR_TRCENA_Pos);

    for (testSize = 0; testSize < (THROUGHPUT_BUFFER_SIZE / 4); ++testSize)
    {
        testThroughputBuffer[testSize] = testSize;
    }

    usb_echo("throughput test:\r\n");
    for (testIndex = 0; testIndex < (sizeof(testSizeArray) / 4); ++testIndex)
    {
        totalTime    = 0;
        blockAddress = 0;
        testSize     = testSizeArray[testIndex] * 1024;
        while (testSize)
        {
            if (msdCommandInstance->deviceState != kStatus_DEV_Attached)
            {
                msd_command_test_done(msdCommandInstance);
                return;
            }
            ufiIng      = 1;
            DWT->CYCCNT = 0;
            DWT->CTRL |= (1 << DWT_CTRL_CYCCNTENA_Pos);
            status =
                USB_HostMsdWrite10(msdCommandInstance->classHandle, 0, blockAddress,
                                   (uint8_t *)&testThroughputBuffer[0], THROUGHPUT_BUFFER_SIZE,
                                   (THROUGHPUT_BUFFER_SIZE / blockSize), USB_HostMsdUfiCallback, msdCommandInstance);
            if (status != kStatus_USB_Success)
            {
                usb_echo("    error\r\n");
                msd_command_test_done(msdCommandInstance);
                return;
            }
            while (ufiIng) /* wait the command */
            {
                USB_HostControllerTaskFunction(g_HostHandle);
            }
            totalTime += DWT->CYCCNT;
            DWT->CTRL &= ~(1U << DWT_CTRL_CYCCNTENA_Pos);
            if (ufiStatus != kStatus_USB_Success)
            {
                usb_echo("fail\r\n");
                msd_command_test_done(msdCommandInstance);
                return;
            }
            testSize -= THROUGHPUT_BUFFER_SIZE;
            blockAddress += (THROUGHPUT_BUFFER_SIZE / blockSize);
        }
        testSize = testSizeArray[testIndex];
        usb_echo("    write %dKB data the speed is %d KB/s\r\n", testSize,
                 (uint32_t)((uint64_t)testSize * (uint64_t)MCU_CORE_CLOCK / (uint64_t)totalTime));

        totalTime    = 0;
        blockAddress = 0;
        testSize     = testSizeArray[testIndex] * 1024;
        while (testSize)
        {
            if (msdCommandInstance->deviceState != kStatus_DEV_Attached)
            {
                msd_command_test_done(msdCommandInstance);
                return;
            }
            ufiIng      = 1;
            DWT->CYCCNT = 0;
            DWT->CTRL |= (1 << DWT_CTRL_CYCCNTENA_Pos);
            status =
                USB_HostMsdRead10(msdCommandInstance->classHandle, 0, blockAddress, (uint8_t *)&testThroughputBuffer[0],
                                  THROUGHPUT_BUFFER_SIZE, (THROUGHPUT_BUFFER_SIZE / blockSize), USB_HostMsdUfiCallback,
                                  msdCommandInstance);
            if (status != kStatus_USB_Success)
            {
                usb_echo("    error\r\n");
                msd_command_test_done(msdCommandInstance);
                return;
            }
            while (ufiIng) /* wait the command */
            {
                USB_HostControllerTaskFunction(g_HostHandle);
            }
            totalTime += DWT->CYCCNT;
            DWT->CTRL &= ~(1U << DWT_CTRL_CYCCNTENA_Pos);
            if (ufiStatus != kStatus_USB_Success)
            {
                usb_echo("fail\r\n");
                msd_command_test_done(msdCommandInstance);
                return;
            }
            testSize -= THROUGHPUT_BUFFER_SIZE;
            blockAddress += (THROUGHPUT_BUFFER_SIZE / blockSize);
        }
        testSize = testSizeArray[testIndex];
        usb_echo("    read %dKB data the speed is %d KB/s\r\n", testSize,
                 (uint32_t)((uint64_t)testSize * (uint64_t)MCU_CORE_CLOCK / (uint64_t)totalTime));
    }
#endif /* MSD_THROUGHPUT_TEST_ENABLE */

    msd_command_test_done(msdCommandInstance); /* all test are done */
}

void USB_HostMsdTask(void *arg)
{
    usb_status_t status;
    usb_host_msd_command_instance_t *msdCommandInstance = (usb_host_msd_command_instance_t *)arg;

    if (msdCommandInstance->deviceState != msdCommandInstance->prevDeviceState)
    {
        msdCommandInstance->prevDeviceState = msdCommandInstance->deviceState;
        switch (msdCommandInstance->deviceState)
        {
            case kStatus_DEV_Idle:
                break;

            case kStatus_DEV_Attached: /* deivce is attached and numeration is done */
                status = USB_HostMsdInit(msdCommandInstance->deviceHandle,
                                         &msdCommandInstance->classHandle); /* msd class initialization */
                if (status != kStatus_USB_Success)
                {
                    usb_echo("usb host msd init fail\r\n");
                    return;
                }
                msdCommandInstance->runState = kUSB_HostMsdRunSetInterface;
                break;

            case kStatus_DEV_Detached: /* device is detached */
                msdCommandInstance->deviceState = kStatus_DEV_Idle;
                msdCommandInstance->runState    = kUSB_HostMsdRunIdle;
                USB_HostMsdDeinit(msdCommandInstance->deviceHandle,
                                  msdCommandInstance->classHandle); /* msd class de-initialization */
                msdCommandInstance->classHandle = NULL;

                usb_echo("mass storage device detached\r\n");
                break;

            default:
                break;
        }
    }

    /* run state */
    switch (msdCommandInstance->runState)
    {
        case kUSB_HostMsdRunIdle:
            break;

        case kUSB_HostMsdRunSetInterface: /* set msd interface */
            msdCommandInstance->runState     = kUSB_HostMsdRunIdle;
            msdCommandInstance->runWaitState = kUSB_HostMsdRunWaitSetInterface;
            status = USB_HostMsdSetInterface(msdCommandInstance->classHandle, msdCommandInstance->interfaceHandle, 0,
                                             USB_HostMsdControlCallback, msdCommandInstance);
            if (status != kStatus_USB_Success)
            {
                usb_echo("set interface fail\r\n");
            }
            break;

        case kUSB_HostMsdRunMassStorageTest:            /* set interface succeed */
            USB_HostMsdCommandTest(msdCommandInstance); /* test msd device */
            msdCommandInstance->runState = kUSB_HostMsdRunIdle;
            break;

        default:
            break;
    }
}

usb_status_t USB_HostMsdEvent(usb_device_handle deviceHandle,
                              usb_host_configuration_handle configurationHandle,
                              uint32_t eventCode)
{
    usb_status_t status = kStatus_USB_Success;
    uint8_t id;
    usb_host_configuration_t *configuration;
    uint8_t interfaceIndex;
    usb_host_interface_t *interface;
    uint32_t infoValue;

    switch (eventCode)
    {
        case kUSB_HostEventAttach:
            usb_echo("kUSB_HostEventAttach\r\n");
            /* judge whether is configurationHandle supported */
            configuration = (usb_host_configuration_t *)configurationHandle;
            for (interfaceIndex = 0; interfaceIndex < configuration->interfaceCount; ++interfaceIndex)
            {
                interface = &configuration->interfaceList[interfaceIndex];
                id        = interface->interfaceDesc->bInterfaceClass;
                if (id != USB_HOST_MSD_CLASS_CODE)
                {
                    continue;
                }
                id = interface->interfaceDesc->bInterfaceSubClass;
                if ((id != USB_HOST_MSD_SUBCLASS_CODE_UFI) && (id != USB_HOST_MSD_SUBCLASS_CODE_SCSI))
                {
                    continue;
                }
                id = interface->interfaceDesc->bInterfaceProtocol;
                if (id != USB_HOST_MSD_PROTOCOL_BULK)
                {
                    continue;
                }
                else
                {
                    if (g_MsdCommandInstance.deviceState == kStatus_DEV_Idle)
                    {
                        /* the interface is supported by the application */
                        g_MsdCommandInstance.testUfiBuffer   = s_TestUfiBuffer;
                        g_MsdCommandInstance.deviceHandle    = deviceHandle;
                        g_MsdCommandInstance.interfaceHandle = interface;
                        g_MsdCommandInstance.configHandle    = configurationHandle;
                        return kStatus_USB_Success;
                    }
                    else
                    {
                        continue;
                    }
                }
            }
            status = kStatus_USB_NotSupported;
            break;

        case kUSB_HostEventNotSupported:
            usb_echo("kUSB_HostEventNotSupported\r\n");
            break;

        case kUSB_HostEventEnumerationDone:
            usb_echo("kUSB_HostEventEnumerationDone\r\n");
            if (g_MsdCommandInstance.configHandle == configurationHandle)
            {
                if ((g_MsdCommandInstance.deviceHandle != NULL) && (g_MsdCommandInstance.interfaceHandle != NULL))
                {
                    /* the device enumeration is done */
                    if (g_MsdCommandInstance.deviceState == kStatus_DEV_Idle)
                    {
                        g_MsdCommandInstance.deviceState = kStatus_DEV_Attached;

                        USB_HostHelperGetPeripheralInformation(deviceHandle, kUSB_HostGetDevicePID, &infoValue);
                        usb_echo("mass storage device attached:pid=0x%x", infoValue);
                        USB_HostHelperGetPeripheralInformation(deviceHandle, kUSB_HostGetDeviceVID, &infoValue);
                        usb_echo("vid=0x%x ", infoValue);
                        USB_HostHelperGetPeripheralInformation(deviceHandle, kUSB_HostGetDeviceAddress, &infoValue);
                        usb_echo("address=%d\r\n", infoValue);
                    }
                    else
                    {
                        usb_echo("not idle msd instance\r\n");
                        status = kStatus_USB_Error;
                    }
                }
            }
            break;

        case kUSB_HostEventDetach:
             usb_echo("kUSB_HostEventDetach\r\n");
            if (g_MsdCommandInstance.configHandle == configurationHandle)
            {
                /* the device is detached */
                g_MsdCommandInstance.configHandle = NULL;
                if (g_MsdCommandInstance.deviceState != kStatus_DEV_Idle)
                {
                    g_MsdCommandInstance.deviceState = kStatus_DEV_Detached;
                }
            }
            break;

        default:
            break;
    }
    return status;
}
```
